## boards/shields/iteration/Kconfig.defconfig
```kconfig
if SHIELD_ITERATION_RIGHT

config ZMK_KEYBOARD_NAME
    default "Iteration"

config ZMK_SPLIT_ROLE_CENTRAL
    default y

config ZMK_SPLIT_BLE_CENTRAL_PERIPHERALS
    default 1

config BT_MAX_CONN
    default 6

config BT_MAX_PAIRED
    default 6

endif

if SHIELD_ITERATION_LEFT || SHIELD_ITERATION_RIGHT

config ZMK_SPLIT
    default y

if SHIELD_ITERATION_RIGHT

config ZMK_DISPLAY
    default y

config ZMK_WIDGET_BATTERY_STATUS
    default y

config ZMK_WIDGET_BATTERY_STATUS_SHOW_PERCENTAGE
    default y

endif

endif

if BOARD_NICE_NANO_V2 && SHIELD_ITERATION_RIGHT

config SPI
    default y

endif
```
